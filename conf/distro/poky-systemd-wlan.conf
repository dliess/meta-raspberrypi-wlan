## conf/distro/poky-systemd-wlan.conf
```bitbake
require conf/distro/poky.conf

DISTRO = "poky-systemd-wlan"
DISTROOVERRIDES = "poky:poky-systemd-wlan"


MACHINE_FEATURES += "wifi"

DISTRO_FEATURES_append = "\
    systemd \
    wifi \
"

IMAGE_FEATURES += "ssh-server-openssh"

VIRTUAL-RUNTIME_init_manager = "systemd"
VIRTUAL-RUNTIME_initscripts = ""
DISTRO_FEATURES_BACKFILL_CONSIDERED = "sysvinit"
```

## conf/layer.conf
```bitbake
# We have a conf and classes directory, add to BBPATH
BBPATH .= ":${LAYERDIR}"

# We have recipes-* directories, add to BBFILES
BBFILES += "${LAYERDIR}/recipes-*/*/*.bb ${LAYERDIR}/recipes-*/*/*.bbappend ${LAYERDIR}/images/*.bb"

BBFILE_COLLECTIONS += "meta-raspberrypi-wlan"

BBFILE_PATTERN_meta-raspberrypi-wlan = "^${LAYERDIR}/"
BBFILE_PRIORITY_meta-raspberrypi-wlan = "1"
LAYERSERIES_COMPAT_meta-raspberrypi-wlan = "dunfell"
```
